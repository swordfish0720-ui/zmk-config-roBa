## boards/shields/roBa/Kconfig.defconfig
```kconfig
if SHIELD_ROBA_R

config ZMK_KEYBOARD_NAME
    default "roBa_R"

config ZMK_SPLIT
    default y

config ZMK_SPLIT_ROLE_CENTRAL
    default y

endif

if SHIELD_ROBA_L

config ZMK_KEYBOARD_NAME
    default "roBa_L"

config ZMK_SPLIT
    default y

endif

//バッテリー残量個別表示
if SHIELD_ROBA_R || SHIELD_ROBA_L

CONFIG_ZMK_SPLIT_BLE_CENTRAL_BATTERY_LEVEL_FETCHING=y
CONFIG_ZMK_SPLIT_BLE_CENTRAL_BATTERY_LEVEL_PROXY=y

endif
```
